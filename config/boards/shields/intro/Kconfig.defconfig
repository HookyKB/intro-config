## config/boards/shields/intro/Kconfig.defconfig
```kconfig
# Copyright (c) 2020 The ZMK Contributors
# SPDX-License-Identifier: MIT

if SHIELD_INTRO_LEFT

config ZMK_KEYBOARD_NAME
	default "Intro"

config ZMK_SPLIT_ROLE_CENTRAL
	default y

endif

config ZMK_SPLIT
	default y
```

## config/boards/shields/intro/Kconfig.shield
```kconfig
# Copyright (c) 2020 The ZMK Contributors
# SPDX-License-Identifier: MIT

config SHIELD_INTRO_LEFT
	def_bool $(shields_list_contains,intro_left)

config SHIELD_INTRO_RIGHT
	def_bool $(shields_list_contains,intro_right)
```
